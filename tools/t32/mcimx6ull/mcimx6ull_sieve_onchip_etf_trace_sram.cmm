; --------------------------------------------------------------------------------
; @Title: Demo script for IMX6ULL on MCIMX6ULL with Onchip-Trace (RAM, ETF)
; @Description:
;   Loads the sieve demo application into RAM and sets up a demo debug
;   scenario.
;   The program flow is traced using the Onchip-Trace (ETF).
;   Prerequisites:
;    * Connect JTAG cable or Combiprobe to J1902
;    * Set bootmode to microSD and remove microSD
;      -> device will stop in bootrom
;      SW601[1..4]=0y0010 - MicroSD
;      SW602[1..2]=0y10   - internal boot
; @Keywords: ARM, Cortex-A7, ETF, ETM
; @Author: AME
; @Board: MCIMX6ULL
; @Chip: IMX6ULL
; @Copyright: (C) 1989-2022 Lauterbach GmbH, licensed for use with TRACE32(R) only
; --------------------------------------------------------------------------------
; $Id: mcimx6ull_sieve_onchip_etf_trace_sram.cmm 18877 2022-02-02 07:04:07Z bschroefel $


WinCLEAR

; --------------------------------------------------------------------------------
; initialize and start the debugger
RESet
SYStem.RESet
SYStem.CPU IMX6ULL
SYStem.Option ResBreak OFF
IF VERSION.BUILD()<92177.
(
  ; adjust WaitReset time if a different bootmode is used
  SYStem.Option WaitReset 10ms
)
ELSE
(
  ; poll till BootROM enables JTAG Pins
  SYStem.Option WaitIDCODE 1.5s
)
SYStem.JtagClock CTCK 10MHz
SYStem.Up

; --------------------------------------------------------------------------------
; load demo program (uses internal RAM only)
Data.LOAD.Elf "~~~~/sieve_ram_arm_v7.elf"

; --------------------------------------------------------------------------------
; start program execution
Go.direct main
WAIT !STATE.RUN()

; --------------------------------------------------------------------------------
; initialize ONCHIP trace (ETF)
Trace.METHOD ONCHIP
ETM.Trace ON
ETM.ON

; enable timestamps for ETM
GOSUB EtmTimestampCalibration

; --------------------------------------------------------------------------------
; open some windows
WinCLEAR
Mode.Hll
WinPOS 0. 0.
List.auto
WinPOS 120. 0. 100. 8.
Frame.view
WinPOS 120. 14.
Var.Watch
Var.AddWatch %SpotLight ast flags
WinPOS 120. 25.
Trace.List
WinPOS 0. 32.
Var.DRAW %DEFault sinewave

ENDDO

; --------------------------------------------------------------------------------

; start the timestamp generator and count the number of ticks in one second
EtmTimestampCalibration: ;()
(
  PRIVATE &tmp
  Data.Set DAP:0x82104000 %Long 0x00000001
  &tmp=Data.Quad(DAP:0x82104000+0x8)
  WAIT 1.s
  &tmp=Data.Quad(DAP:0x82104000+0x8)-&tmp
  ETM.TimeStampClock &(tmp)
  ETM.TimeStamps ON
  RETURN
)
